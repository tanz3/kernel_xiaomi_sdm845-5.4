## drivers/staging/android/ion/Kconfig
```kconfig
# SPDX-License-Identifier: GPL-2.0
menuconfig ION
	bool "Ion Memory Manager"
	depends on HAS_DMA && MMU
	select GENERIC_ALLOCATOR
	select DMA_SHARED_BUFFER
	help
	  Choose this option to enable the ION Memory Manager,
	  used by Android to efficiently allocate buffers
	  from userspace that can be shared between drivers.
	  If you're not using Android its probably safe to
	  say N here.

source "drivers/staging/android/ion/heaps/Kconfig"

config ION_LEGACY
	bool "Legacy ion"
	depends on ION
	help
	  Choose this option to enable the legacy ion. If in doubt, say N.
```
